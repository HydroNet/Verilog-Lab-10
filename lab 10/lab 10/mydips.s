		GLOBAL user_code
		IMPORT	LCD_pinss
		IMPORT	LCD_inits
		IMPORT	LCD_clear
		IMPORT	LCD_cmds
		IMPORT	LCD_strings
		IMPORT BRANCHBACK
			AREA mycode, CODE, readonly
			
IO0PIN EQU 0XE0028000
	
user_code 
		BL LCD_pinss
		BL LCD_inits
		LDR R0,=IO0PIN
		MOV R1, #0X40000000
		LDR R2,[R0]
		ORR R2,R2,R1
		STR R2,[R0]
		MOV R6, #0X80000000
		BL LCD_cmds
		BL LCD_clear
		MOV R6, #0XF0;CURSOR SET AT LOCATION 00 LINE 1
		LDR R8, =STRING1
		BL LCD_strings
		;BL LCD_clear
		MOV R6, #0XC0;CURSOR SET AT LOCATION 40 LINE 2
		LDR R8, =STRING2
		BL LCD_strings	
		B  BRANCHBACK

STRING1 DCB "BEST",0
STRING2 DCB "PROFESSOR",0
		ALIGN
		END